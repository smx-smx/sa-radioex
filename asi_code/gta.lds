PROVIDE("_GTEXT_GetRadioStationName@4" = 0x004E9E10);
PROVIDE(_GTEXT_IsRadioOn = 0x004E8350);
PROVIDE(_GTEXT_StartTrackPlayback = 0x004EA640);

PROVIDE(_GDATA_RadioIndex = 0x008CB7E1);
PROVIDE(_GDATA_StopStatus1 = 0x00BA68A5);
PROVIDE(_GDATA_StopStatus2 = 0x00B6F5F0);
PROVIDE(_GDATA_RadioVolume = 0x00B5FCC8);
PROVIDE(_GDATA_RadioState = 0x008CB6F8);